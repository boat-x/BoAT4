## Kconfig
```kconfig
menu "BoAT v4 SDK Configuration"

config BOAT_EVM_ENABLED
    bool "Enable EVM chain support (Ethereum, Base, Polygon, etc.)"
    default y

config BOAT_SOL_ENABLED
    bool "Enable Solana chain support"
    default y

menu "Payment Protocols"

config BOAT_PAY_X402_ENABLED
    bool "Enable x402 payment protocol"
    depends on BOAT_EVM_ENABLED
    default n

config BOAT_PAY_NANO_ENABLED
    bool "Enable Circle Nanopayments"
    depends on BOAT_EVM_ENABLED
    default n

config BOAT_PAY_GATEWAY_ENABLED
    bool "Enable Circle Gateway"
    depends on BOAT_EVM_ENABLED || BOAT_SOL_ENABLED
    default n

endmenu

menu "Key Management"

config BOAT_KEY_SE_ENABLED
    bool "Enable Secure Element backend"
    default n

config BOAT_KEY_TEE_ENABLED
    bool "Enable TEE backend"
    default n

endmenu

choice BOAT_PAL
    prompt "Platform Abstraction Layer"
    default BOAT_PAL_LINUX

config BOAT_PAL_LINUX
    bool "Linux (POSIX + libcurl)"

config BOAT_PAL_CUSTOM
    bool "Custom (user-provided)"

endchoice

endmenu
```
